## firmware/sdkconfig.defaults
```kconfig
# BananaGuard node — ESP-IDF defaults (ESP32, 4 MB flash)

CONFIG_IDF_TARGET="esp32"

# Flash / partitions
CONFIG_ESPTOOLPY_FLASHSIZE_4MB=y
CONFIG_PARTITION_TABLE_CUSTOM=y
CONFIG_PARTITION_TABLE_CUSTOM_FILENAME="partitions.csv"

# Main task needs headroom for the imaging pipeline glue (frame buffers are
# heap-allocated, but downscale/diff run on the main task).
CONFIG_ESP_MAIN_TASK_STACK_SIZE=16384

# Task watchdog: enabled, but the main task subscribes/feeds explicitly
# (see event_log.c / main.c).
CONFIG_ESP_TASK_WDT_EN=y
CONFIG_ESP_TASK_WDT_TIMEOUT_S=30
CONFIG_ESP_TASK_WDT_CHECK_IDLE_TASK_CPU0=n

# Brownout detector — reset early so the event logger can record the cause
# on the next boot instead of corrupting flash mid-write.
CONFIG_ESP_BROWNOUT_DET=y
CONFIG_ESP_BROWNOUT_DET_LVL_SEL_7=y

# Keep RTC slow memory powered in deep sleep: the detection aggregator,
# spray lockout and reference frame live there.
CONFIG_ESP_SLEEP_POWER_DOWN_FLASH=n

# SPIFFS for the event log
CONFIG_SPIFFS_MAX_PARTITIONS=1

# Log verbosity: INFO for field builds; flip to DEBUG while bringing up.
CONFIG_LOG_DEFAULT_LEVEL_INFO=y
```
